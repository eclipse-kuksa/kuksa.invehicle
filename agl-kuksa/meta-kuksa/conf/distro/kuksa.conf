## agl-kuksa/meta-kuksa/conf/distro/kuksa.conf
```bitbake
#
# ******************************************************************************
# Copyright (c) 2018 Robert Bosch GmbH and others.
#
# All rights reserved. This program and the accompanying materials
# are made available under the terms of the Eclipse Public License v2.0
# which accompanies this distribution, and is available at
# https://www.eclipse.org/org/documents/epl-2.0/index.php
#
#  Contributors:
#      Robert Bosch GmbH - initial API and functionality
# *****************************************************************************

# Distro Layer configuration
# include and overwrite default poky-agl distro
include conf/distro/poky-agl.conf
DISTRO = "kuksa"
DISTRO_NAME = "AGL Kuksa"
DISTRO_VERSION = "0.0.0"
DISTRO_CODENAME = "arp"
SDK_VENDOR = "-kuksasdk"
SDK_VERSION="${DISTRO_VERSION}"
MAINTAINER = "pedro.cuadrachamorro@fh-dortmund.de"

TARGET_VENDOR = "-kuksa"

# Override these in poky based distros
KUKSA_DEFAULT_DISTRO_FEATURES = ""
KUKSA_DEFAULT_EXTRA_RDEPENDS = ""
KUKSA_DEFAULT_EXTRA_RRECOMMENDS = ""

DISTRO_EXTRA_RDEPENDS += " ${KUKSA_DEFAULT_EXTRA_RDEPENDS}"
DISTRO_EXTRA_RRECOMMENDS += " ${KUKSA_DEFAULT_EXTRA_RRECOMMENDS}"

DISTRO_FEATURES ?= "${KUKSA_DEFAULT_DISTRO_FEATURES} ${DISTRO_FEATURES_LIBC} "
```

## agl-kuksa/meta-kuksa/conf/layer.conf
```bitbake
#
# ******************************************************************************
# Copyright (c) 2018 Robert Bosch GmbH and others.
#
# All rights reserved. This program and the accompanying materials
# are made available under the terms of the Eclipse Public License v2.0
# which accompanies this distribution, and is available at
# https://www.eclipse.org/org/documents/epl-2.0/index.php
#
#  Contributors:
#      Robert Bosch GmbH - initial API and functionality
# *****************************************************************************

BBPATH .= ":${LAYERDIR}"

BBFILES += "${LAYERDIR}/recipes-*/*/*.bb \
	${LAYERDIR}/recipes-*/*/*.bbappend"

BBFILE_COLLECTIONS += "meta-kuksa"
BBFILE_PATTERN_meta-kuksa = "^${LAYERDIR}/"
BBFILE_PRIORITY_meta-kuksa = "11"

PACKAGECONFIG_append_pn-connman = " 3g"

# Add the packages to the image
IMAGE_INSTALL_append = " \
        w3c-visserver-api \
        elm327-visdatafeeder \
        datalogger-http \
        datalogger-mqtt \
        remoteaccess \
        python3-pip \
        python3-requests \
        kuksa-hawkbit \
        wifi-conf \
        docker \
        boost "

TOOLCHAIN_TARGET_TASK_append = " \
	boost-dev \
        boost-staticdev"

DISTRO_FEATURES_append = " virtualization"
```

## agl-kuksa/meta-kuksa/meta-kuksa-bsp/conf/layer.conf
```bitbake
# We have a conf and classes directory, add to BBPATH
BBPATH =. "${LAYERDIR}:"

# Let us add layer-specific bbappends which are only applied when that
# layer is included in our configuration -
# e.g. only add layers if a bsp is present.
# This is based on the BBFILE_COLLECTIONS name of the layer.
# We use either the BBFILE_COLLECTIONS name of the layer directly (meta-ti)
BBFILES += "${@' '.join('${LAYERDIR}/%s/recipes*/*/*.bbappend' % layer \
               for layer in BBFILE_COLLECTIONS.split())}"
BBFILES += "${@' '.join('${LAYERDIR}/%s/recipes*/*/*.bb' % layer \
               for layer in BBFILE_COLLECTIONS.split())}"
# or we prepend it with meta-  (e.g. rpi, fsl*)
BBFILES += "${@' '.join('${LAYERDIR}/meta-%s/recipes*/*/*.bbappend' % layer \
               for layer in BBFILE_COLLECTIONS.split())}"
BBFILES += "${@' '.join('${LAYERDIR}/meta-%s/recipes*/*/*.bb' % layer \
               for layer in BBFILE_COLLECTIONS.split())}"

# Add shared recipes among BSPs
BBFILES += "${LAYERDIR}/recipes-*/*/*.bb ${LAYERDIR}/recipes-*/*/*.bbappend"

BBFILE_COLLECTIONS += "kuksabsp"
BBFILE_PATTERN_kuksabsp = "^${LAYERDIR}/"
BBFILE_PRIORITY_kuksabsp = "10"

IMAGE_INSTALL_append = " \
        kuksa-fota"
```

## agl-kuksa/meta-kuksa/meta-kuksa-bsp/wic/sdimage-raspberrypi.wks
```
# short-description: Create Raspberry Pi SD card image
# long-description: Creates a partitioned SD card image for use with
# Raspberry Pi. Boot files are located in the first vfat partition.
# For FOTA update functionality an additional empty partition is added

part /boot --source bootimg-partition --ondisk mmcblk0 --fstype=vfat --label boot --active --align 4096 --size 20
part / --source rootfs --ondisk mmcblk0 --fstype=ext4 --label rootA --align 4096
part --ondisk mmcblk0 --size 3500 --fstype=ext4 --label rootB --align 4096
```
